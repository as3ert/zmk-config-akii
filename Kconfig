## Kconfig
```kconfig
config ZMK_KSCAN_AKII_TWOTIER
    bool "AKII two-tier MCP23017 kscan driver"
    default y if DT_HAS_ZMK_KSCAN_AKII_TWOTIER_ENABLED
    # depends on (not select) KSCAN: ZMK_KSCAN already selects KSCAN (default y)
    # and provides CONFIG_KSCAN_INIT_PRIORITY. `select KSCAN` here creates a
    # Kconfig recursive-dependency loop (KSCAN subtree -> GPIO kscan -> I2C),
    # so we depend on it instead.
    depends on I2C && KSCAN
    help
      Custom two-tier keyboard scanner for the AKII board's 2x MCP23017 I2C
      expanders, talked to over raw I2C (no gpio-controller driver).

      ACTIVE: full matrix scan every active-poll-period-ms -> stock feel.
      IDLE:   after idle-timeout-ms of no activity, drive all rows low and do a
              cheap "any column pulled low?" summary read every
              idle-poll-period-ms; any key down jumps back to ACTIVE.

      Gets idle current down to the slow-poll floor (~0.4mA on this board)
      while keeping typing latency at the active-scan rate.
```

## config/west.yml
```yaml
manifest:
  remotes:
    - name: zmkfirmware
      url-base: https://github.com/zmkfirmware
  projects:
    - name: zmk
      remote: zmkfirmware
      # Pinned (was: main) to a fixed Zephyr (v4.1.0+zmk-fixes, via ZMK's
      # app/west.yml) so the custom kscan driver doesn't bitrot on upstream.
      # NOTE: the kscan subsystem is marked DEPRECATED in this Zephyr; the build
      # is clean today, but a future Zephyr bump may require migrating the
      # driver (kscan_driver_api / CONFIG_KSCAN_INIT_PRIORITY) to the input
      # subsystem. Commit 2026-06-07.
      revision: ff09f2d0c9f13a868c8f71d71d9348ade438e4b6
      import: app/west.yml
  self:
    path: config
```

## dts/bindings/kscan/zmk,kscan-akii-twotier.yaml
```yaml
description: |
  AKII two-tier kscan driver. Owns both MCP23017 expanders over raw I2C.
  The node sits on the I2C bus; "reg" is the column-side expander (mcp_c)
  and "addr-rows" is the row-side expander (mcp_r).

compatible: "zmk,kscan-akii-twotier"

include: [kscan.yaml, i2c-device.yaml]

properties:
  addr-rows:
    type: int
    required: true
    description: I2C address of the row-side MCP23017 (rows + COL0-7).

  idle-poll-period-ms:
    type: int
    default: 80
    description: Summary-read interval while idle.

  active-poll-period-ms:
    type: int
    default: 5
    description: Full matrix scan interval while active.

  idle-timeout-ms:
    type: int
    default: 750
    description: No-activity time before dropping from active to idle.

  debounce-press-ms:
    type: int
    default: 5
    description: Debounce time; rounded up to a whole number of active scans.

  debounce-release-ms:
    type: int
    default: 5
    description: Reserved for symmetric debounce (currently uses press value).
```
